## drivers/flash/Kconfig.stm32_fmc
```kconfig
# STM32 FMC flash driver configuration options

# Copyright (c) 2025 Endress+Hauser GmbH+Co. KG
# SPDX-License-Identifier: Apache-2.0

DT_STM32_FMC_NAND_HAS_DMA := $(dt_compat_any_has_prop,$(DT_COMPAT_ST_STM32_FMC_NAND),dmas)

config FLASH_STM32_FMC_NAND
	bool "STM32 FMC NAND Flash driver"
	default y
	depends on DT_HAS_ST_STM32_FMC_NAND_ENABLED
	select MEMC
	select USE_STM32_LL_FMC
	select USE_STM32_HAL_NAND
	select FLASH_HAS_DRIVER_ENABLED
	select FLASH_PAGE_LAYOUT
	select FLASH_HAS_PAGE_LAYOUT
	select FLASH_HAS_EXPLICIT_ERASE
	select DMA if $(DT_STM32_FMC_NAND_HAS_DMA)
	select USE_STM32_HAL_DMA if $(DT_STM32_FMC_NAND_HAS_DMA)
	help
	  Enable parallel NAND flash support on the STM32 family of processors.
```

## drivers/watchdog/Kconfig.adm682x
```kconfig
# Copyright (c) 2025 Analog Devices, Inc.
# Copyright (c) 2025 Endress+Hauser AG
# SPDX-License-Identifier: Apache-2.0

config WDT_ADM682X
	bool "Driver for the ADM682X watchdog family."
	default y
	depends on DT_HAS_ADI_ADM682_WATCHDOG_ENABLED
	select HAS_WDT_DISABLE_AT_BOOT
	help
	  Enable support for external ADM682X family watchdog.
```

## dts/bindings/flash_controller/micron,mt29f4g08.yaml
```yaml
# Copyright (c) 2025 Endress+Hauser GmbH+Co. KG
# SPDX-License-Identifier: Apache-2.0

description: |
  NAND flash driver for Micron MT29F4G08 flash memory.

  The MT29F4G08 is a 4 Gb NAND flash organised in pages of 2048 bytes each.

  Refer to the Micron MT29F4G08 datasheet for more details.

compatible: "micron,mt29f4g08"

properties:
  reg:
    type: int
    required: true

  page_size:
    type: int
    required: true

  spare_area_size:
    type: int
    required: true

  block_size:
    type: int
    required: true

  plane_size:
    type: int
    required: true

  flash_size:
    type: int
    required: true
```

## dts/bindings/memory-controllers/st,stm32-fmc-nand.yaml
```yaml
# Copyright (c) 2025 Endress+Hauser GmbH+Co. KG
# SPDX-License-Identifier: Apache-2.0

description: |
  STM32 Flexible Memory Controller (NAND flash controller).

  The FMC generates the appropriate signal timings to drive 8- and 16-bit NAND flash memories.

  A unique Chip Select signal (NE) is used per bank. All the other signals (addresses, data and
  control) are shared. A wide range of devices is supported through programmable timings.

  Refer to the reference manual for more details.

  The FMC NAND controller is defined below the FMC node and banks are defined as child nodes of
  the FMC NAND controller node.

  An optional DMA channel specifier can be provided to enable memory-to-memory transfers using DMA.
  The specifier should hold a phandle reference to the DMA controller, the channel number, the slot
  number (unused for memory-to-memory transfers) and channel configuration. The followed DMA
  channel name must be "tx_rx".

  You can enable the controller in the devicetree as follows:

  &fmc {
    status = "okay";
    pinctrl-0 = <&fmc_nce_pc8 &fmc_ale_pd12 ...>;
    pinctrl-names = "default";

    nand-controller {
      compatible = "st,stm32-fmc-nand";
      status = "okay";

      #address-cells = <1>;
      #size-cells = <0>;

      dmas = <&dma1 2 0 0x0000>;
      dma-names = "tx_rx";

      nand-flash@3 {
        reg = <0x3>;
      };
    };
  };

  Use constants defined in dt-bindings/memory-controller/stm32-fmc-nand.h (TODO) and
  dt-bindings/dma/stm32_dma.h.

compatible: "st,stm32-fmc-nand"

include: base.yaml

properties:
  "#address-cells":
    required: true
    const: 1

  "#size-cells":
    required: true
    const: 0

child-binding:
  description: NAND bank.

  properties:
    reg:
      type: int
      required: true
      description: |
        NAND bank value. This is used to select the bank to which the flash device is connected.
        It should be equal to a value of STM32_FMC_NAND_BANKx (TODO).
```

## dts/bindings/mtd/mspi-is66wvo8m8.yaml
```yaml
# Copyright (c) 2024, Ambiq Micro Inc. <www.ambiq.com>
# SPDX-License-Identifier: Apache-2.0

description: ISSI IS66/67 WVO8M8DALL/BLL PSRAM driver.

compatible: "mspi-is66wvo8m8"

include: [mspi-device.yaml, "jedec,jesd216.yaml"]

properties:
  reset-gpios:
    type: phandle-array
    description: |
      Optional reset pin of the device.

  setup-tx-dummy:
    type: int
    default: 0
    description: |
      TX dummy cycles used for configuration.

  setup-rx-dummy:
    type: int
    default: 15
    description: |
      RX dummy cycles used for configuration.

  dqsm-read-pre-cycle:
    type: boolean
    description: |
      Enable DQSM pre cycle read (need to add 1 to RX dummy cycles).

  fixed-latency:
    type: boolean
    description: |
      Operate PSRAM in fixed latency mode.

  hybrid-mode:
    type: boolean
    description: |
      Operate PSRAM in hybrid mode.

  latency-counter:
    type: string
    default: "LC_7_CLK"
    description: |
      Latency counter (LC) of the PSRAM.
    enum:
      - "LC_3_CLK"
      - "LC_4_CLK"
      - "LC_5_CLK"
      - "LC_6_CLK"
      - "LC_7_CLK"
      - "LC_8_CLK"

  output-driver-strength:
    type: string
    default: "ODS_DEFAULT_OHMS"
    description: |
      Output driver strength in Ohms.
    enum:
      - "ODS_100_OHMS"
      - "ODS_66_OHMS"
      - "ODS_50_OHMS"
      - "ODS_40_OHMS"
      - "ODS_33_OHMS"
      - "ODS_33_OHMS_2"
      - "ODS_25_OHMS"
      - "ODS_DEFAULT_OHMS"

  wrapped-burst-sequence:
    type: string
    default: "WRAP_32"
    description: |
      Wrapped burst sequence count in bytes.
    enum:
      - "WRAP_128"
      - "WRAP_64"
      - "WRAP_32"
      - "WRAP_16"
      - "WRAP_128_HYBRID"
      - "WRAP_64_HYBRID"
      - "WRAP_32_HYBRID"
      - "WRAP_16_HYBRID"

  partial-array-refresh:
    type: string
    default: "REFRESH_FULL"
    description: |
      Settings for partial array refresh.
    enum:
      - "REFRESH_FULL"
      - "REFRESH_BOTTOM_HALF"
      - "REFRESH_BOTTOM_QUARTER"
      - "REFRESH_BOTTOM_EIGHTH"
      - "REFRESH_RESERVED"
      - "REFRESH_TOP_HALF"
      - "REFRESH_TOP_QUARTER"
      - "REFRESH_TOP_EIGHTH"
```

## dts/bindings/watchdog/adi,adm682x-watchdog.yaml
```yaml
# Copyright (c) 2025 Analog Devices, Inc.
# Copyright (c) 2025 Endress+Hauser AG
# SPDX-License-Identifier: Apache-2.0

description: ADM682X Watchdog

compatible: "adi,adm682x-watchdog"

include: base.yaml

properties:
  wdi-gpios:
    type: phandle-array
    required: true
    description: |
      The GPIO pin used to feed the watchdog.
```
